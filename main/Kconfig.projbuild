## main/Kconfig.projbuild
```kconfig
menu "Envirotracker"

config ENVIROTRACKER_WIFI_SSID
    string "Wi-Fi SSID"
    default ""

config ENVIROTRACKER_WIFI_PASSWORD
    string "Wi-Fi password"
    default ""

config ENVIROTRACKER_DEVICE_ID
    string "Unique device id"
    default "unset"

config ENVIROTRACKER_MQTT_HOST_URI
    string "MQTT Host"
    default ""

config ENVIROTRACKER_MQTT_PORT
    int "MQTT Port"
    default 1883

config ENVIROTRACKER_MQTT_USERNAME
    string "MQTT Username"
    default ""

config ENVIROTRACKER_MQTT_PASSWORD
    string "MQTT Password"
    default ""

config ENVIROTRACKER_MQTT_TLS
    bool "MQTT Via TLS"
    default false
endmenu
```
